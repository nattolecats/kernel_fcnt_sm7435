## drivers/input/fingerprint/fpc/Kconfig
```kconfig
config FP_FPC1020
	tristate "FPC1020 fingerprint driver support"
	help
	  Say Y here to enable FPC1020 fingerprint driver support!
```

## drivers/misc/ledpulse/Kconfig
```kconfig
# SPDX-License-Identifier: GPL-2.0-only
#
# MAX30101 LEDPULSE driver configuration
#

config LEDPULSE_MAX30101
	tristate "LEDPULSE_MAX30101_I2C_Driver"
	help
	  Support for LEDPULSE_MAX30101 driver IC, using this driver,
	  user can set different values to control this

	  Say m if you want to enable ISL97900 driver.
```
